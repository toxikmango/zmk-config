## config/kconfig.defconfig
```kconfig
if SHIELD_MY_BOARD

config ZMK_KEYBOARD_NAME
    default "Firefly"
	

if LVGL

config LVGL_HOR_RES_MAX
	default 128

config LVGL_VER_RES_MAX
	default 32

config LVGL_VDB_SIZE
	default 64

config LVGL_DPI
	default 148

config LVGL_BITS_PER_PIXEL
	default 1

choice LVGL_COLOR_DEPTH
	default LVGL_COLOR_DEPTH_1
endchoice

endif # LVGL
endif
```

## west.yml
```yaml
# manifest:
#   remotes:
#     - name: zmkfirmware
#       url-base: https://github.com/zmkfirmware
#   projects:
#     - name: zmk
#       remote: zmkfirmware
#       revision: main
#       import: app/west.yml
#   self:
#     path: config
manifest:
  remotes:
    - name: zmkfirmware
      url-base: https://github.com/toxikmango
    - name: zmkfirmware
      url-base: https://github.com/toxikmango
  projects:
    - name: zmk
      remote: zmkfirmware
      revision: firefly
      import: app/west.yml
  self:
    path: config
```
