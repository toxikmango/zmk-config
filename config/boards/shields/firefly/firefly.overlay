#include <dt-bindings/zmk/matrix_transform.h>

/ {
	kscan0: kscan {
		compatible = "zmk,kscan-gpio-matrix";
		label = "KSCAN";

		diode-direction = "col2row";

		row-gpios
			= <&pro_micro 13(GPIO_ACTIVE_HIGH | GPIO_PULL_DOWN)>
			, <&pro_micro 14 (GPIO_ACTIVE_HIGH | GPIO_PULL_DOWN)>
			, <&pro_micro 15 (GPIO_ACTIVE_HIGH | GPIO_PULL_DOWN)>
			, <&pro_micro 16 (GPIO_ACTIVE_HIGH | GPIO_PULL_DOWN)>
			, <&pro_micro 17 (GPIO_ACTIVE_HIGH | GPIO_PULL_DOWN)>
			;

		col-gpios
			= <&pro_micro 18 (GPIO_ACTIVE_HIGH | GPIO_PULL_DOWN)>
			, <&pro_micro 19 (GPIO_ACTIVE_HIGH | GPIO_PULL_DOWN)>
			, <&pro_micro 20 (GPIO_ACTIVE_HIGH | GPIO_PULL_DOWN)>
			, <&pro_micro 12 (GPIO_ACTIVE_HIGH | GPIO_PULL_DOWN)>
			;

	};
	&encoder_1 
	status = "okay";
	}
	&encoder_2 {
	status = "okay";

};	
